## main/Kconfig.projbuild
```kconfig
menu "Connection Configuration"

config WIFI_SSID
    string "WiFi SSID"
	default "myssid"

config WIFI_PASSWORD
    string "WiFi Password"
	default "mypassword"

config WEBAPI_SERVER
    string "Web API server address"
    default "example.com"

config WEBAPI_PORT
    string "Web API port"
    default "443"

config WEBAPI_URL
    string "Web API URL"
    default "https://example.com/post.cgi"

config WEBAPI_AUTH
    string "Web API Basic auth string"
    default "userid:password"

endmenu
```
